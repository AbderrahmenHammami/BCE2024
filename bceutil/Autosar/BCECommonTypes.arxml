AUTOSAR XML (schema 4-2-2)
package /ZSG/DataTypes
  55 x impl type, all with category=ARRAY:
    UcArray8
      element UcArray8_elements: array-size=8, array-size-semantics=FIXED-SIZE, implementation-data-type=UInt8
    Array8
      element Array8_elements: array-size=8, array-size-semantics=FIXED-SIZE, implementation-data-type=UInt8
    ByteArray8
      element ByteArray8_elements: array-size=8, array-size-semantics=FIXED-SIZE, implementation-data-type=UInt8
    ByteArray1
      element ByteArray1_elements: array-size=1, array-size-semantics=FIXED-SIZE, implementation-data-type=UInt8
    ByteArray2
      element ByteArray2_elements: array-size=2, array-size-semantics=FIXED-SIZE, implementation-data-type=UInt8
    ByteArray3
      element ByteArray3_elements: array-size=3, array-size-semantics=FIXED-SIZE, implementation-data-type=UInt8
    ByteArray5
      element ByteArray5_elements: array-size=5, array-size-semantics=FIXED-SIZE, implementation-data-type=UInt8
    ByteArray6
      element ByteArray6_elements: array-size=6, array-size-semantics=FIXED-SIZE, implementation-data-type=UInt8
    ByteArray7
      element ByteArray7_elements: array-size=7, array-size-semantics=FIXED-SIZE, implementation-data-type=UInt8
    UcArray16
      element UcArray16_elements: array-size=16, array-size-semantics=FIXED-SIZE, implementation-data-type=UInt8
    UlArray80
      element UlArray80_elements: array-size=80, array-size-semantics=FIXED-SIZE, implementation-data-type=UInt32
    ByteArray128
      element ByteArray128_elements: array-size=128, array-size-semantics=FIXED-SIZE, implementation-data-type=UInt8
    ByteArray132
      element ByteArray132_elements: array-size=132, array-size-semantics=FIXED-SIZE, implementation-data-type=UInt8
    ByteArray20
      element ByteArray20_elements: array-size=20, array-size-semantics=FIXED-SIZE, implementation-data-type=UInt8
    ByteArray26
      element ByteArray26_elements: array-size=26, array-size-semantics=FIXED-SIZE, implementation-data-type=UInt8
    ByteArray4
      element ByteArray4_elements: array-size=4, array-size-semantics=FIXED-SIZE, implementation-data-type=UInt8
    ByteArray72
      element ByteArray72_elements: array-size=72, array-size-semantics=FIXED-SIZE, implementation-data-type=UInt8
    ByteArray19
      element ByteArray19_elements: array-size=19, array-size-semantics=FIXED-SIZE, implementation-data-type=UInt8
    ByteArray9
      element ByteArray9_elements: array-size=9, array-size-semantics=FIXED-SIZE, implementation-data-type=UInt8
    ByteArray64
      element ByteArray64_elements: array-size=64, array-size-semantics=FIXED-SIZE, implementation-data-type=UInt8
    ByteArray65
      element ByteArray65_elements: array-size=65, array-size-semantics=FIXED-SIZE, implementation-data-type=UInt8
    ByteArray264
      element ByteArray264_elements: array-size=264, array-size-semantics=FIXED-SIZE, implementation-data-type=UInt8
    ByteArray40
      element ByteArray40_elements: array-size=40, array-size-semantics=FIXED-SIZE, implementation-data-type=UInt8
    ByteArray42
      element ByteArray42_elements: array-size=42, array-size-semantics=FIXED-SIZE, implementation-data-type=UInt8
    ByteArray50
      element ByteArray50_elements: array-size=50, array-size-semantics=FIXED-SIZE, implementation-data-type=UInt8
    ByteArray60
      element ByteArray60_elements: array-size=60, array-size-semantics=FIXED-SIZE, implementation-data-type=UInt8
    ByteArray146
      element ByteArray146_elements: array-size=146, array-size-semantics=FIXED-SIZE, implementation-data-type=UInt8
    UcArray3
      element UcArray3_elements: array-size=3, array-size-semantics=FIXED-SIZE, implementation-data-type=UInt8
    CArray8
      element CArray8_elements: array-size=8, array-size-semantics=FIXED-SIZE, implementation-data-type=SInt8
    UcArray2
      element UcArray2_elements: array-size=2, array-size-semantics=FIXED-SIZE, implementation-data-type=UInt8
    UcArray4
      element UcArray4_elements: array-size=4, array-size-semantics=FIXED-SIZE, implementation-data-type=UInt8
    CArray3
      element CArray3_elements: array-size=3, array-size-semantics=FIXED-SIZE, implementation-data-type=SInt8
    ByteArray32
      element ByteArray32_elements: array-size=32, array-size-semantics=FIXED-SIZE, implementation-data-type=UInt8
    ByteArray112
      element ByteArray112_elements: array-size=112, array-size-semantics=FIXED-SIZE, implementation-data-type=UInt8
    ByteArray82
      element ByteArray82_elements: array-size=82, array-size-semantics=FIXED-SIZE, implementation-data-type=UInt8
    ByteArray12
      element ByteArray12_elements: array-size=12, array-size-semantics=FIXED-SIZE, implementation-data-type=UInt8
    ByteArray48
      element ByteArray48_elements: array-size=48, array-size-semantics=FIXED-SIZE, implementation-data-type=UInt8
    SIArray1
      element SIArray1_elements: array-size=1, array-size-semantics=FIXED-SIZE, implementation-data-type=UInt16
    ByteArray10
      element ByteArray10_elements: array-size=10, array-size-semantics=FIXED-SIZE, implementation-data-type=UInt8
    ByteArray16
      element ByteArray16_elements: array-size=16, array-size-semantics=FIXED-SIZE, implementation-data-type=UInt8
    ByteArray17
      element ByteArray17_elements: array-size=17, array-size-semantics=FIXED-SIZE, implementation-data-type=UInt8
    ByteArray25
      element ByteArray25_elements: array-size=25, array-size-semantics=FIXED-SIZE, implementation-data-type=UInt8
    ByteArray34
      element ByteArray34_elements: array-size=34, array-size-semantics=FIXED-SIZE, implementation-data-type=UInt8
    SIArray25
      element SIArray25_elements: array-size=25, array-size-semantics=FIXED-SIZE, implementation-data-type=UInt16
    ByteArray14
      element ByteArray14_elements: array-size=14, array-size-semantics=FIXED-SIZE, implementation-data-type=UInt8
    ByteArray100
      element ByteArray100_elements: array-size=100, array-size-semantics=FIXED-SIZE, implementation-data-type=UInt8
    ByteArray21
      element ByteArray21_elements: array-size=21, array-size-semantics=FIXED-SIZE, implementation-data-type=UInt8
    UlArray5
      element UlArray5_elements: array-size=5, array-size-semantics=FIXED-SIZE, implementation-data-type=UInt32
    ByteArray92
      element ByteArray92_elements: array-size=92, array-size-semantics=FIXED-SIZE, implementation-data-type=UInt8
    ByteArray24
      element ByteArray24_elements: array-size=24, array-size-semantics=FIXED-SIZE, implementation-data-type=UInt8
    ByteArray129
      element ByteArray129_elements: array-size=129, array-size-semantics=FIXED-SIZE, implementation-data-type=UInt8
    ByteArray11
      element ByteArray11_elements: array-size=11, array-size-semantics=FIXED-SIZE, implementation-data-type=UInt8
    ByteArray516
      element ByteArray516_elements: array-size=516, array-size-semantics=FIXED-SIZE, implementation-data-type=UInt8
    ByteArray124
      element ByteArray124_elements: array-size=124, array-size-semantics=FIXED-SIZE, implementation-data-type=UInt8
    ByteArray13
      element ByteArray13_elements: array-size=13, array-size-semantics=FIXED-SIZE, implementation-data-type=UInt8
