AUTOSAR XML (schema 4-2-2)
standard types defined: Boolean, SInt16, SInt32, SInt8, UInt16, UInt32, UInt64, UInt8
package /BMW/Vbf/Units
  24 x unit:
    percent: display-name=%  # a percentage is a way of expressing a number as a fraction of 100 (no SI unit).
    percent_per_second: display-name=%/s  # time-derivative of percent
    degree_centigrade: display-name=degC  # temperature, no SI unit, (degC = kelvin - 273.16)
    bar: display-name=bar  # pressure, no SI unit; 1 bar = 100,000 pascals (Pa)
    hertz: display-name=Hz  # SI unit of frequency
    kilogram: display-name=kg  # SI base unit of mass
    kilometer: display-name=km  # length, no SI unit
    meter: display-name=m  # SI base unit of length
    meter_per_second: display-name=m/s  # velocity (derived from SI units)
    meter_per_second_squared: display-name=m/s^2  # acceleration (derived from SI units)
    newton: display-name=N  # SI unit of force
    newton_meter: display-name=Nm  # torque (= kg m^2/s^2) ; (derived from SI units)
    newton_meter_per_second: display-name=Nm/s  # time-derivative of torque
    radian: display-name=rad  # SI unit of measuring plane angle (dimensionless)
    radian_per_second: display-name=rad/s  # angular velocity (derived from SI units)
    radian_per_second_squared: display-name=rad/s^2  # SI unit of angular acceleration
    revolutions_per_minute: display-name=rpm  # revolutions per minute - no SI unit
    rpm_per_second: display-name=rpm/s  # time-derivative of revolutions per minute - no SI unit
    second: display-name=s  # SI base unit of time
    volt: display-name=V  # electric potential difference (derived from SI units)
    hecto_pascal: display-name=hPa  # The pascal (symbol: Pa) is the SI derived unit of pressure or stress (also: Young's modulus and tensile strength). It is equivalent to one newton per square meter. In everyday life, the pascal is perhaps best known from meteorological air-pressure reports, where it occurs in the form of hectopascal (1 hPa = 100 Pa).
    newton_per_meter: display-name=N/m  # surface tension (derived from SI units).
    newton_sec_per_meter: display-name=Ns/m  # damping factor or coefficient (derived from SI units)
    meter_per_second_toPowOf3: display-name=m/s^3  # jerk (derived from SI units), also called jolt (esp. in British English), surge or lurch, is the rate of change of acceleration; more precisely, the derivative of acceleration with respect to time, the second derivative of velocity, or the third derivative of displacement.
package /BMW/Vbf/DataTypes
  58 x impl type, all with category=VALUE:
    SInt1: base-type=sint8, range phys -1..0, raw -1..0  # 1 bit signed integer
    SInt10: base-type=sint16, range phys -512..511, raw -512..511  # 10 bit signed integer
    SInt11: base-type=sint16, range phys -1024..1023, raw -1024..1023  # 11 bit signed integer
    SInt12: base-type=sint16, range phys -2048..2047, raw -2048..2047  # 12 bit signed integer
    SInt13: base-type=sint16, range phys -4096..4095, raw -4096..4095  # 13 bit signed integer
    SInt14: base-type=sint16, range phys -8192..8191, raw -8192..8191  # 14 bit signed integer
    SInt15: base-type=sint16, range phys -16384..16383, raw -16384..16383  # 15 bit signed integer
    SInt17: base-type=sint32, range phys -65536..65535, raw -65536..65535  # 17 bit signed integer
    SInt18: base-type=sint32, range phys -131072..131071, raw -131072..131071  # 18 bit signed integer
    SInt19: base-type=sint32, range phys -262144..262143, raw -262144..262143  # 19 bit signed integer
    SInt2: base-type=sint8, range phys -2..1, raw -2..1  # 2 bit signed integer
    SInt20: base-type=sint32, range phys -524288..524287, raw -524288..524287  # 20 bit signed integer
    SInt21: base-type=sint32, range phys -1048576..1048575, raw -1048576..1048575  # 21 bit signed integer
    SInt22: base-type=sint32, range phys -2097152..2097151, raw -2097152..2097151  # 22 bit signed integer
    SInt23: base-type=sint32, range phys -4194304..4194303, raw -4194304..4194303  # 23 bit signed integer
    SInt24: base-type=sint32, range phys -8388608..8388607, raw -8388608..8388607  # 24 bit signed integer
    SInt25: base-type=sint32, range phys -16777216..16777215, raw -16777216..16777215  # 25 bit signed integer
    SInt26: base-type=sint32, range phys -33554432..33554431, raw -33554432..33554431  # 26 bit signed integer
    SInt27: base-type=sint32, range phys -67108864..67108863, raw -67108864..67108863  # 27 bit signed integer
    SInt28: base-type=sint32, range phys -134217728..134217727, raw -134217728..134217727  # 28 bit signed integer
    SInt29: base-type=sint32, range phys -268435456..268435455, raw -268435456..268435455  # 29 bit signed integer
    SInt3: base-type=sint8, range phys -4..3, raw -4..3  # 3 bit signed integer
    SInt30: base-type=sint32, range phys -536870912..536870911, raw -536870912..536870911  # 30 bit signed integer
    SInt31: base-type=sint32, range phys -1073741824..1073741823, raw -1073741824..1073741823  # 31 bit signed integer
    SInt4: base-type=sint8, range phys -8..7, raw -8..7  # 4 bit signed integer
    SInt5: base-type=sint8, range phys -16..15, raw -16..15  # 5 bit signed integer
    SInt6: base-type=sint8, range phys -32..31, raw -32..31  # 6 bit signed integer
    SInt7: base-type=sint8, range phys -64..63, raw -64..63  # 7 bit signed integer
    SInt9: base-type=sint16, range phys -256..255, raw -256..255  # 9 bit signed integer
    UInt1: base-type=uint8, range phys 0..1, raw 0..1  # 1 bit unsigned integer
    UInt10: base-type=uint16, range phys 0..1023, raw 0..1023  # 10 bit unsigned integer
    UInt11: base-type=uint16, range phys 0..2047, raw 0..2047  # 11 bit unsigned integer
    UInt12: base-type=uint16, range phys 0..4095, raw 0..4095  # 12 bit unsigned integer
    UInt13: base-type=uint16, range phys 0..8191, raw 0..8191  # 13 bit unsigned integer
    UInt14: base-type=uint16, range phys 0..16383, raw 0..16383  # 14 bit unsigned integer
    UInt15: base-type=uint16, range phys 0..32767, raw 0..32767  # 15 bit unsigned integer
    UInt17: base-type=uint32, range phys 0..131071, raw 0..131071  # 17 bit unsigned integer
    UInt18: base-type=uint32, range phys 0..262143, raw 0..262143  # 18 bit unsigned integer
    UInt19: base-type=uint32, range phys 0..524287, raw 0..524287  # 19 bit unsigned integer
    UInt2: base-type=uint8, range phys 0..3, raw 0..3  # 2 bit unsigned integer
    UInt20: base-type=uint32, range phys 0..1048575, raw 0..1048575  # 20 bit unsigned integer
    UInt21: base-type=uint32, range phys 0..2097151, raw 0..2097151  # 21 bit unsigned integer
    UInt22: base-type=uint32, range phys 0..4194303, raw 0..4194303  # 22 bit unsigned integer
    UInt23: base-type=uint32, range phys 0..8388607, raw 0..8388607  # 23 bit unsigned integer
    UInt24: base-type=uint32, range phys 0..16777215, raw 0..16777215  # 24 bit unsigned integer
    UInt25: base-type=uint32, range phys 0..33554431, raw 0..33554431  # 25 bit unsigned integer
    UInt26: base-type=uint32, range phys 0..67108863, raw 0..67108863  # 26 bit unsigned integer
    UInt27: base-type=uint32, range phys 0..134217727, raw 0..134217727  # 27 bit unsigned integer
    UInt28: base-type=uint32, range phys 0..268435455, raw 0..268435455  # 28 bit unsigned integer
    UInt29: base-type=uint32, range phys 0..536870911, raw 0..536870911  # 29 bit unsigned integer
    UInt3: base-type=uint8, range phys 0..7, raw 0..7  # 3 bit unsigned integer
    UInt30: base-type=uint32, range phys 0..1073741823, raw 0..1073741823  # 30 bit unsigned integer
    UInt31: base-type=uint32, range phys 0..2147483647, raw 0..2147483647  # 31 bit unsigned integer
    UInt4: base-type=uint8, range phys 0..15, raw 0..15  # 4 bit unsigned integer
    UInt5: base-type=uint8, range phys 0..31, raw 0..31  # 5 bit unsigned integer
    UInt6: base-type=uint8, range phys 0..63, raw 0..63  # 6 bit unsigned integer
    UInt7: base-type=uint8, range phys 0..127, raw 0..127  # 7 bit unsigned integer
    UInt9: base-type=uint16, range phys 0..511, raw 0..511  # 9 bit unsigned integer
package /BMW/Vbf/ApplicationDataTypes
  64 x app type, all with category=VALUE:
    SInt1: range phys -1..0, raw -1..0  # 1 bit signed integer
    SInt10: range phys -512..511, raw -512..511  # 10 bit signed integer
    SInt11: range phys -1024..1023, raw -1024..1023  # 11 bit signed integer
    SInt12: range phys -2048..2047, raw -2048..2047  # 12 bit signed integer
    SInt13: range phys -4096..4095, raw -4096..4095  # 13 bit signed integer
    SInt14: range phys -8192..8191, raw -8192..8191  # 14 bit signed integer
    SInt15: range phys -16384..16383, raw -16384..16383  # 15 bit signed integer
    SInt16: range phys -32768..32767, raw -32768..32767  # 16 bit signed integer
    SInt17: range phys -65536..65535, raw -65536..65535  # 17 bit signed integer
    SInt18: range phys -131072..131071, raw -131072..131071  # 18 bit signed integer
    SInt19: range phys -262144..262143, raw -262144..262143  # 19 bit signed integer
    SInt2: range phys -2..1, raw -2..1  # 2 bit signed integer
    SInt20: range phys -524288..524287, raw -524288..524287  # 20 bit signed integer
    SInt21: range phys -1048576..1048575, raw -1048576..1048575  # 21 bit signed integer
    SInt22: range phys -2097152..2097151, raw -2097152..2097151  # 22 bit signed integer
    SInt23: range phys -4194304..4194303, raw -4194304..4194303  # 23 bit signed integer
    SInt24: range phys -8388608..8388607, raw -8388608..8388607  # 24 bit signed integer
    SInt25: range phys -16777216..16777215, raw -16777216..16777215  # 25 bit signed integer
    SInt26: range phys -33554432..33554431, raw -33554432..33554431  # 26 bit signed integer
    SInt27: range phys -67108864..67108863, raw -67108864..67108863  # 27 bit signed integer
    SInt28: range phys -134217728..134217727, raw -134217728..134217727  # 28 bit signed integer
    SInt29: range phys -268435456..268435455, raw -268435456..268435455  # 29 bit signed integer
    SInt3: range phys -4..3, raw -4..3  # 3 bit signed integer
    SInt30: range phys -536870912..536870911, raw -536870912..536870911  # 30 bit signed integer
    SInt31: range phys -1073741824..1073741823, raw -1073741824..1073741823  # 31 bit signed integer
    SInt32: range phys -2147483648..2147483647, raw -2147483648..2147483647  # 32 bit signed integer
    SInt4: range phys -8..7, raw -8..7  # 4 bit signed integer
    SInt5: range phys -16..15, raw -16..15  # 5 bit signed integer
    SInt6: range phys -32..31, raw -32..31  # 6 bit signed integer
    SInt7: range phys -64..63, raw -64..63  # 7 bit signed integer
    SInt8: range phys -128..127, raw -128..127  # 8 bit signed integer
    SInt9: range phys -256..255, raw -256..255  # 9 bit signed integer
    UInt1: range phys 0..1, raw 0..1  # 1 bit unsigned integer
    UInt10: range phys 0..1023, raw 0..1023  # 10 bit unsigned integer
    UInt11: range phys 0..2047, raw 0..2047  # 11 bit unsigned integer
    UInt12: range phys 0..4095, raw 0..4095  # 12 bit unsigned integer
    UInt13: range phys 0..8191, raw 0..8191  # 13 bit unsigned integer
    UInt14: range phys 0..16383, raw 0..16383  # 14 bit unsigned integer
    UInt15: range phys 0..32767, raw 0..32767  # 15 bit unsigned integer
    UInt16: range phys 0..65535, raw 0..65535  # 16 bit unsigned integer
    UInt17: range phys 0..131071, raw 0..131071  # 17 bit unsigned integer
    UInt18: range phys 0..262143, raw 0..262143  # 18 bit unsigned integer
    UInt19: range phys 0..524287, raw 0..524287  # 19 bit unsigned integer
    UInt2: range phys 0..3, raw 0..3  # 2 bit unsigned integer
    UInt20: range phys 0..1048575, raw 0..1048575  # 20 bit unsigned integer
    UInt21: range phys 0..2097151, raw 0..2097151  # 21 bit unsigned integer
    UInt22: range phys 0..4194303, raw 0..4194303  # 22 bit unsigned integer
    UInt23: range phys 0..8388607, raw 0..8388607  # 23 bit unsigned integer
    UInt24: range phys 0..16777215, raw 0..16777215  # 24 bit unsigned integer
    UInt25: range phys 0..33554431, raw 0..33554431  # 25 bit unsigned integer
    UInt26: range phys 0..67108863, raw 0..67108863  # 26 bit unsigned integer
    UInt27: range phys 0..134217727, raw 0..134217727  # 27 bit unsigned integer
    UInt28: range phys 0..268435455, raw 0..268435455  # 28 bit unsigned integer
    UInt29: range phys 0..536870911, raw 0..536870911  # 29 bit unsigned integer
    UInt3: range phys 0..7, raw 0..7  # 3 bit unsigned integer
    UInt30: range phys 0..1073741823, raw 0..1073741823  # 30 bit unsigned integer
    UInt31: range phys 0..2147483647, raw 0..2147483647  # 31 bit unsigned integer
    UInt32: range phys 0..4294967295, raw 0..4294967295  # 32 bit unsigned integer
    UInt4: range phys 0..15, raw 0..15  # 4 bit unsigned integer
    UInt5: range phys 0..31, raw 0..31  # 5 bit unsigned integer
    UInt6: range phys 0..63, raw 0..63  # 6 bit unsigned integer
    UInt7: range phys 0..127, raw 0..127  # 7 bit unsigned integer
    UInt8: range phys 0..255, raw 0..255  # 8 bit unsigned integer
    UInt9: range phys 0..511, raw 0..511  # 9 bit unsigned integer
package /BMW/Vbf/DataTypeMappingSets
  data type mapping set BmwVbfStdTypes
    data-type-maps:
      application-data-type=SInt1, implementation-data-type=SInt1
      application-data-type=SInt{10..19}, implementation-data-type=SInt{10..19}
      application-data-type=SInt2, implementation-data-type=SInt2
      application-data-type=SInt{20..29}, implementation-data-type=SInt{20..29}
      application-data-type=SInt3, implementation-data-type=SInt3
      application-data-type=SInt{30..32}, implementation-data-type=SInt{30..32}
      application-data-type=SInt{4..9}, implementation-data-type=SInt{4..9}
      application-data-type=UInt1, implementation-data-type=UInt1
      application-data-type=UInt{10..19}, implementation-data-type=UInt{10..19}
      application-data-type=UInt2, implementation-data-type=UInt2
      application-data-type=UInt{20..29}, implementation-data-type=UInt{20..29}
      application-data-type=UInt3, implementation-data-type=UInt3
      application-data-type=UInt{30..32}, implementation-data-type=UInt{30..32}
      application-data-type=UInt{4..9}, implementation-data-type=UInt{4..9}
