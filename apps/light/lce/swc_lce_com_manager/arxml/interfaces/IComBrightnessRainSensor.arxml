AUTOSAR XML (schema 4-2-2)
package /Default
  sender receiver interface IComBrightness_Rain_Sensor
    data ST_RB_LIN: type=IComBrightness_Rain_Sensor_ST_RB_LIN_Type
  impl type IComBrightness_Rain_Sensor_ST_RB_LIN_Type: category=VALUE, base-type=uint8
