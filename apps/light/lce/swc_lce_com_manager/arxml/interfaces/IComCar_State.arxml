AUTOSAR XML (schema 4-2-2)
package /Default
  sender receiver interface IComCar_State
    data VEH_ST: type=IComCar_State_VEH_ST_Type
  impl type IComCar_State_VEH_ST_Type: category=VALUE, base-type=uint8
