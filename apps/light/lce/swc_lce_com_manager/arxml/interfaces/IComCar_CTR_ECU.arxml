AUTOSAR XML (schema 4-2-2)
package /Default
  sender receiver interface IComCar_CTR_ECU
    data CTR_FN_LCU: type=IComCar_CTR_FN_LCU_Type
    data CTR_FN_BRS: type=IComCar_CTR_FN_BRS_Type
  impl type IComCar_CTR_FN_LCU_Type: category=VALUE, base-type=uint8
  impl type IComCar_CTR_FN_BRS_Type: category=VALUE, base-type=uint8
