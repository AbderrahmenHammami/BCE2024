AUTOSAR XML (schema 4-2-2)
package /Default
  sender receiver interface IComMotor_Speed
    data Motor_Speed: type=IComMotor_Speed_Motor_Speed_Type
  impl type IComMotor_Speed_Motor_Speed_Type: category=VALUE, base-type=uint8
