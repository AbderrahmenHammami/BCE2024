AUTOSAR XML (schema 4-2-2)
package /Default
  sender receiver interface IComECU_Voltage
    data BCE_Voltage: type=IComBCE_Voltage_Type
  impl type IComBCE_Voltage_Type: category=VALUE, base-type=float32
