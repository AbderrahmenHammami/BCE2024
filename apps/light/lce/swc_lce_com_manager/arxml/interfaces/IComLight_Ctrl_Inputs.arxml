AUTOSAR XML (schema 4-2-2)
package /Default
  sender receiver interface IComLight_Ctrl_Inputs
    data ST_LP_LIN: type=IComLight_Ctrl_Inputs_ST_LP_LIN_Type
  impl type IComLight_Ctrl_Inputs_ST_LP_LIN_Type: category=VALUE, base-type=uint8
